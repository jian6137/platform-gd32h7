/*!
    \file    lcd_console.c
    \brief   On-screen diagnostic console and text renderer for GD32H759I TLI LCD
*/

#include "lcd_console.h"
#include "gd32h7xx.h"
#include <string.h>
#include <stdio.h>

static const uint16_t ASCII8x16_Table[] = {
    0x00, 0x00, 0x00, 0x00, 0x00, 0x00, 0x00, 0x00, 0x00, 0x00, 0x00, 0x00, 0x00, 0x00, 0x00, 0x00, /* Space */
    0x00, 0x00, 0x18, 0x3C, 0x3C, 0x3C, 0x18, 0x18, 0x18, 0x00, 0x18, 0x18, 0x00, 0x00, 0x00, 0x00, /* ! */
    0x00, 0x66, 0x66, 0x66, 0x24, 0x00, 0x00, 0x00, 0x00, 0x00, 0x00, 0x00, 0x00, 0x00, 0x00, 0x00, /* " */
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    0x00, 0x00, 0x00, 0x00, 0x10, 0x38, 0x6C, 0xC6, 0xC6, 0xC6, 0xFE, 0x00, 0x00, 0x00, 0x00, 0x00
};

static uint16_t s_cursor_x = 0U;
static uint16_t s_cursor_y = 0U;
static uint16_t s_fg_color = CONSOLE_COLOR_WHITE;
static uint16_t s_bg_color = CONSOLE_COLOR_DARKBLUE;
static uint8_t  s_usart_initialized = 0U;

static void usart_debug_init(void)
{
    if (s_usart_initialized) {
        return;
    }
    rcu_periph_clock_enable(RCU_GPIOA);
    rcu_periph_clock_enable(RCU_USART0);

    gpio_af_set(GPIOA, GPIO_AF_7, GPIO_PIN_9 | GPIO_PIN_10);
    gpio_mode_set(GPIOA, GPIO_MODE_AF, GPIO_PUPD_PULLUP, GPIO_PIN_9 | GPIO_PIN_10);
    gpio_output_options_set(GPIOA, GPIO_OTYPE_PP, GPIO_OSPEED_100_220MHZ, GPIO_PIN_9 | GPIO_PIN_10);

    usart_deinit(USART0);
    usart_baudrate_set(USART0, 115200U);
    usart_receive_config(USART0, USART_RECEIVE_ENABLE);
    usart_transmit_config(USART0, USART_TRANSMIT_ENABLE);
    usart_enable(USART0);

    s_usart_initialized = 1U;
}

static void usart_send_char(char c)
{
    if (!s_usart_initialized) {
        usart_debug_init();
    }
    if (c == '\n') {
        usart_data_transmit(USART0, (uint8_t)'\r');
        while (RESET == usart_flag_get(USART0, USART_FLAG_TBE)) {}
    }
    usart_data_transmit(USART0, (uint8_t)c);
    while (RESET == usart_flag_get(USART0, USART_FLAG_TBE)) {}
}

void lcd_console_init(uint16_t bg_color, uint16_t fg_color)
{
    s_bg_color = bg_color;
    s_fg_color = fg_color;
    s_cursor_x = 0U;
    s_cursor_y = 0U;

    usart_debug_init();
    lcd_console_clear();
}

void lcd_console_set_color(uint16_t fg_color)
{
    s_fg_color = fg_color;
}

void lcd_console_set_bg_color(uint16_t bg_color)
{
    s_bg_color = bg_color;
}

void lcd_console_clear(void)
{
    volatile uint16_t *frame = (volatile uint16_t *)DISPLAY_FRAMEBUFFER;
    for (uint32_t i = 0U; i < (LCD_WIDTH * LCD_HEIGHT); ++i) {
        frame[i] = s_bg_color;
    }
    s_cursor_x = 0U;
    s_cursor_y = 0U;
    lcd_console_flush();
}

static void draw_char_bitmap(uint16_t col, uint16_t row, char c, uint16_t fg, uint16_t bg)
{
    volatile uint16_t *frame = (volatile uint16_t *)DISPLAY_FRAMEBUFFER;
    uint16_t px = col * 8U;
    uint16_t py = row * 16U;

    if ((unsigned char)c < 32U || (unsigned char)c > 126U) {
        c = ' ';
    }
    uint32_t font_idx = ((uint32_t)c - 32U) * 16U;

    for (uint32_t y = 0U; y < 16U; ++y) {
        uint16_t line_bits = ASCII8x16_Table[font_idx + y];
        uint32_t fb_offset = (py + y) * LCD_WIDTH + px;
        for (uint32_t x = 0U; x < 8U; ++x) {
            frame[fb_offset + x] = (line_bits & (0x80U >> x)) ? fg : bg;
        }
    }
}

static void console_scroll_up(void)
{
    volatile uint16_t *frame = (volatile uint16_t *)DISPLAY_FRAMEBUFFER;
    memmove((void *)frame, (const void *)(frame + (16U * LCD_WIDTH)),
            (16U * (LCD_CONSOLE_ROWS - 1U) * LCD_WIDTH * sizeof(uint16_t)));

    uint32_t start_idx = 16U * (LCD_CONSOLE_ROWS - 1U) * LCD_WIDTH;
    uint32_t end_idx = LCD_WIDTH * LCD_HEIGHT;
    for (uint32_t i = start_idx; i < end_idx; ++i) {
        frame[i] = s_bg_color;
    }
    s_cursor_y = LCD_CONSOLE_ROWS - 1U;
}

void lcd_console_putc(char c)
{
    usart_send_char(c);

    if (c == '\r') {
        s_cursor_x = 0U;
        return;
    }
    if (c == '\n') {
        s_cursor_x = 0U;
        s_cursor_y++;
        if (s_cursor_y >= LCD_CONSOLE_ROWS) {
            console_scroll_up();
        }
        return;
    }
    if (c == '\t') {
        s_cursor_x = (s_cursor_x + 4U) & ~3U;
        if (s_cursor_x >= LCD_CONSOLE_COLS) {
            s_cursor_x = 0U;
            s_cursor_y++;
            if (s_cursor_y >= LCD_CONSOLE_ROWS) {
                console_scroll_up();
            }
        }
        return;
    }

    draw_char_bitmap(s_cursor_x, s_cursor_y, c, s_fg_color, s_bg_color);
    s_cursor_x++;
    if (s_cursor_x >= LCD_CONSOLE_COLS) {
        s_cursor_x = 0U;
        s_cursor_y++;
        if (s_cursor_y >= LCD_CONSOLE_ROWS) {
            console_scroll_up();
        }
    }
}

void lcd_console_print(const char *str)
{
    if (str == NULL) {
        return;
    }
    while (*str) {
        lcd_console_putc(*str++);
    }
    lcd_console_flush();
}

void lcd_console_printf(const char *fmt, ...)
{
    char buf[256];
    va_list args;

    va_start(args, fmt);
    vsnprintf(buf, sizeof(buf), fmt, args);
    va_end(args);

    lcd_console_print(buf);
}

void lcd_console_flush(void)
{
    SCB_CleanDCache_by_Addr((volatile void *)DISPLAY_FRAMEBUFFER, (int32_t)LCD_FRAME_BYTES);
    tli_reload_config(TLI_REQUEST_RELOAD_EN);
}

void lcd_draw_string_xy(uint16_t px, uint16_t py, const char *str, uint16_t fg, uint16_t bg)
{
    if (str == NULL) {
        return;
    }
    volatile uint16_t *frame = (volatile uint16_t *)DISPLAY_FRAMEBUFFER;
    while (*str) {
        char c = *str++;
        if ((unsigned char)c < 32U || (unsigned char)c > 126U) {
            c = ' ';
        }
        uint32_t font_idx = ((uint32_t)c - 32U) * 16U;
        for (uint32_t y = 0U; y < 16U; ++y) {
            if ((py + y) >= LCD_HEIGHT) {
                break;
            }
            uint16_t line_bits = ASCII8x16_Table[font_idx + y];
            uint32_t fb_offset = (py + y) * LCD_WIDTH + px;
            for (uint32_t x = 0U; x < 8U; ++x) {
                if ((px + x) >= LCD_WIDTH) {
                    break;
                }
                frame[fb_offset + x] = (line_bits & (0x80U >> x)) ? fg : bg;
            }
        }
        px += 8U;
        if (px >= LCD_WIDTH) {
            break;
        }
    }
}

static const uint16_t s_speaker_icon_16x16[16] = {
    0x0000U, 0x0080U, 0x0180U, 0x03E4U,
    0x0FF2U, 0x1FF1U, 0x3FF1U, 0x3FF1U,
    0x3FF1U, 0x3FF1U, 0x1FF1U, 0x0FF2U,
    0x03E4U, 0x0180U, 0x0080U, 0x0000U
};

static const uint16_t s_mute_icon_16x16[16] = {
    0x0000U, 0x0080U, 0x0180U, 0x03E0U,
    0x0FF0U, 0x1FF0U, 0x3FF9U, 0x3FF6U,
    0x3FF6U, 0x3FF9U, 0x1FF0U, 0x0FF0U,
    0x03E0U, 0x0180U, 0x0080U, 0x0000U
};

void lcd_draw_volume_osd(uint8_t volume_percent)
{
    const uint32_t osd_w = 176U;
    const uint32_t osd_h = 56U;
    const uint32_t osd_x = (LCD_WIDTH - osd_w) / 2U;
    const uint32_t osd_y = (LCD_HEIGHT - osd_h) / 2U;
    const int r = 8;
    const int r2 = r * r;
    const int r_in2 = (r - 2) * (r - 2);
    const uint16_t osd_bg = 0x10A2U;
    const uint16_t osd_border = CONSOLE_COLOR_CYAN;

    volatile uint16_t *frame = (volatile uint16_t *)DISPLAY_FRAMEBUFFER;
    uint32_t x, y;

    for (y = 0U; y < osd_h; ++y) {
        uint32_t screen_y = osd_y + y;
        uint32_t row_offset = screen_y * LCD_WIDTH;

        for (x = 0U; x < osd_w; ++x) {
            uint32_t screen_x = osd_x + x;
            int dx = 0;
            int dy = 0;
            bool is_corner = false;

            if (x < (uint32_t)r && y < (uint32_t)r) {
                dx = (int)((uint32_t)r - 1U - x);
                dy = (int)((uint32_t)r - 1U - y);
                is_corner = true;
            } else if (x >= (osd_w - (uint32_t)r) && y < (uint32_t)r) {
                dx = (int)(x - (osd_w - (uint32_t)r));
                dy = (int)((uint32_t)r - 1U - y);
                is_corner = true;
            } else if (x < (uint32_t)r && y >= (osd_h - (uint32_t)r)) {
                dx = (int)((uint32_t)r - 1U - x);
                dy = (int)(y - (osd_h - (uint32_t)r));
                is_corner = true;
            } else if (x >= (osd_w - (uint32_t)r) && y >= (osd_h - (uint32_t)r)) {
                dx = (int)(x - (osd_w - (uint32_t)r));
                dy = (int)(y - (osd_h - (uint32_t)r));
                is_corner = true;
            }

            if (is_corner) {
                int dist2 = dx * dx + dy * dy;
                if (dist2 <= r2) {
                    frame[row_offset + screen_x] = (dist2 >= r_in2) ? osd_border : osd_bg;
                }
            } else {
                bool is_edge = (x < 2U || x >= (osd_w - 2U) || y < 2U || y >= (osd_h - 2U));
                frame[row_offset + screen_x] = is_edge ? osd_border : osd_bg;
            }
        }
    }

    const uint32_t icon_x = osd_x + 14U;
    const uint32_t icon_y = osd_y + 10U;
    const uint16_t icon_color = (volume_percent > 0U) ? CONSOLE_COLOR_GREEN : CONSOLE_COLOR_RED;
    const uint16_t *icon_data = (volume_percent > 0U) ? s_speaker_icon_16x16 : s_mute_icon_16x16;

    for (y = 0U; y < 16U; ++y) {
        uint16_t bits = icon_data[y];
        uint32_t fb_row = (icon_y + y) * LCD_WIDTH + icon_x;
        for (x = 0U; x < 16U; ++x) {
            if (bits & (0x8000U >> x)) {
                frame[fb_row + x] = icon_color;
            }
        }
    }

    char vol_str[16];
    if (volume_percent == 0U) {
        snprintf(vol_str, sizeof(vol_str), "VOL:  0%% [MUTE]");
    } else {
        snprintf(vol_str, sizeof(vol_str), "VOL: %3u%%", (unsigned int)volume_percent);
    }
    lcd_draw_string_xy(osd_x + 36U, osd_y + 10U, vol_str, CONSOLE_COLOR_WHITE, osd_bg);

    const uint32_t bar_x = osd_x + 14U;
    const uint32_t bar_y = osd_y + 34U;
    const uint32_t bar_w = 148U;
    const uint32_t bar_h = 10U;
    const uint32_t bar_fill = (bar_w * (uint32_t)volume_percent) / 100U;

    for (x = 0U; x < bar_w + 2U; ++x) {
        frame[(bar_y - 1U) * LCD_WIDTH + (bar_x - 1U + x)] = CONSOLE_COLOR_LIGHTGRAY;
        frame[(bar_y + bar_h) * LCD_WIDTH + (bar_x - 1U + x)] = CONSOLE_COLOR_LIGHTGRAY;
    }
    for (y = 0U; y < bar_h; ++y) {
        frame[(bar_y + y) * LCD_WIDTH + (bar_x - 1U)] = CONSOLE_COLOR_LIGHTGRAY;
        frame[(bar_y + y) * LCD_WIDTH + (bar_x + bar_w)] = CONSOLE_COLOR_LIGHTGRAY;
    }

    for (y = 0U; y < bar_h; ++y) {
        uint32_t fb_bar_row = (bar_y + y) * LCD_WIDTH + bar_x;
        for (x = 0U; x < bar_w; ++x) {
            if (x < bar_fill) {
                frame[fb_bar_row + x] = (volume_percent > 0U) ? CONSOLE_COLOR_GREEN : CONSOLE_COLOR_RED;
            } else {
                frame[fb_bar_row + x] = 0x2104U;
            }
        }
    }
}

